/dts-v1/;
/plugin/;

/ {
    compatible = "brcm,bcm2712";

    fragment@0 {
        target = <&i2c1>;

        __overlay__ {
            #address-cells = <1>;
            #size-cells = <0>;
            status = "okay";

            bmp280@76 {
                compatible = "alghazali,bmp280";
                reg = <0x76>;
            };
        };
    };
};
